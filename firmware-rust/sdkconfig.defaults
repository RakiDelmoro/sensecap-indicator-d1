## firmware-rust/sdkconfig.defaults
```kconfig
# SenseCAP Indicator D1 - ESP32-S3 Configuration

# Flash size
CONFIG_ESPTOOLPY_FLASHSIZE_8MB=y
CONFIG_ESPTOOLPY_FLASHSIZE="8MB"

# CPU frequency
CONFIG_ESP32S3_DEFAULT_CPU_FREQ_240=y

# PSRAM
CONFIG_ESP32S3_SPIRAM_SUPPORT=y
CONFIG_ESP32S3_SPIRAM_MODE_OCT=y

# WiFi
CONFIG_ESP_WIFI_ENABLED=y

# LVGL Configuration
CONFIG_LV_USE_PERF_MONITOR=y
CONFIG_LV_MEM_CUSTOM=y
CONFIG_LV_MEMCPY_MEMSET_STD=y

# Display resolution
CONFIG_LV_HOR_RES_MAX=480
CONFIG_LV_VER_RES_MAX=480
CONFIG_LV_DISP_DEF_REFR_PERIOD=10

# MQTT
CONFIG_MQTT_PROTOCOL_311=y

# Logging
CONFIG_LOG_DEFAULT_LEVEL_INFO=y
CONFIG_LOG_MAXIMUM_LEVEL=3

# Stack sizes
CONFIG_ESP_MAIN_TASK_STACK_SIZE=8192
CONFIG_ESP_SYSTEM_EVENT_TASK_STACK_SIZE=4096

# FreeRTOS
CONFIG_FREERTOS_UNICORE=n
CONFIG_FREERTOS_HZ=1000

# Enable C++ exceptions for esp-idf-svc
CONFIG_COMPILER_CXX_EXCEPTIONS=y
CONFIG_COMPILER_CXX_RTTI=y
```

## firmware/main/Kconfig.projbuild
```kconfig
menu "SenseCAP Indicator Configuration"

    config WIFI_SSID
        string "WiFi SSID"
        default "your_wifi_ssid"
        help
            SSID (network name) to connect to.

    config WIFI_PASSWORD
        string "WiFi Password"
        default "your_wifi_password"
        help
            WiFi password (WPA or WPA2) to use.

    config WIFI_MAXIMUM_RETRY
        int "WiFi Maximum Retry"
        default 5
        help
            Maximum number of WiFi connection retry attempts.

    config MQTT_BROKER_URL
        string "MQTT Broker URL"
        default "mqtt://broker.hivemq.com:1883"
        help
            URL of the MQTT broker to connect to.
            Format: mqtt://broker:port or mqtts://broker:port for TLS

    config MQTT_USERNAME
        string "MQTT Username"
        default ""
        help
            Username for MQTT authentication (optional).

    config MQTT_PASSWORD
        string "MQTT Password"
        default ""
        help
            Password for MQTT authentication (optional).

endmenu
```

## firmware/sdkconfig.defaults.template
```kconfig
# ============================================================================
# SenseCAP Indicator D1 - Configuration Template
# ============================================================================
# IMPORTANT: This is a TEMPLATE file with placeholder values.
# 
# To use:
#   1. Copy this file to sdkconfig.defaults:
#      cp sdkconfig.defaults.template sdkconfig.defaults
#   
#   2. Edit sdkconfig.defaults with YOUR actual credentials
#   
#   3. The sdkconfig.defaults file is gitignored - never commit credentials!
# 
# ============================================================================

# Partition table
CONFIG_PARTITION_TABLE_CUSTOM=y
CONFIG_PARTITION_TABLE_CUSTOM_FILENAME="partitions.csv"
CONFIG_PARTITION_TABLE_FILENAME="partitions.csv"

# Flash size
CONFIG_ESPTOOLPY_FLASHSIZE_8MB=y
CONFIG_ESPTOOLPY_FLASHSIZE="8MB"

# CPU frequency
CONFIG_ESP_DEFAULT_CPU_FREQ_MHZ_240=y

# WiFi
CONFIG_ESP_WIFI_ENABLED=y

# LVGL configuration
CONFIG_LV_CONF_SKIP=n
CONFIG_LV_CONF_MINIMAL=n

# Enable FreeRTOS features
CONFIG_FREERTOS_HZ=1000

# Enable double buffer for display
CONFIG_LV_DISP_DEF_REFR_PERIOD=10

# Memory settings
CONFIG_ESP_MAIN_TASK_STACK_SIZE=8192
CONFIG_ESP_SYSTEM_EVENT_TASK_STACK_SIZE=4096

# Enable C++ exceptions (needed for Rust interop)
CONFIG_COMPILER_CXX_EXCEPTIONS=y

# Enable float support in printf
CONFIG_NEWLIB_NANO_FORMAT=n

# SPIRAM settings (if available)
CONFIG_ESP32S3_SPIRAM_SUPPORT=n

# ============================================================================
# DEVICE CONFIGURATION - EDIT THESE WITH YOUR VALUES
# ============================================================================

# WiFi Credentials
# Replace with your actual WiFi network name and password
CONFIG_WIFI_SSID="YOUR_WIFI_SSID_HERE"
CONFIG_WIFI_PASSWORD="YOUR_WIFI_PASSWORD_HERE"
CONFIG_WIFI_MAXIMUM_RETRY=5

# MQTT Broker Configuration
# Replace with your MQTT broker URL
# Examples:
#   - Local broker: mqtt://192.168.1.100:1883
#   - HiveMQ public: mqtt://broker.hivemq.com:1883
#   - TLS broker: mqtts://your-broker.com:8883
CONFIG_MQTT_BROKER_URL="mqtt://your-broker-ip:1883"

# MQTT Authentication (optional - leave empty if not required)
CONFIG_MQTT_USERNAME=""
CONFIG_MQTT_PASSWORD=""

# Example with authentication:
# CONFIG_MQTT_USERNAME="your_mqtt_username"
# CONFIG_MQTT_PASSWORD="your_mqtt_password"
```

## sensecap-firmware/sdkconfig.defaults
```kconfig
# Rust often needs a bit of an extra main task stack size compared to C (the default is 3K)
CONFIG_ESP_MAIN_TASK_STACK_SIZE=8000

# Use this to set FreeRTOS kernel tick frequency to 1000 Hz (100 Hz by default).
# This allows to use 1 ms granularity for thread sleeps (10 ms by default).
#CONFIG_FREERTOS_HZ=1000

# Workaround for https://github.com/espressif/esp-idf/issues/7631
#CONFIG_MBEDTLS_CERTIFICATE_BUNDLE=n
#CONFIG_MBEDTLS_CERTIFICATE_BUNDLE_DEFAULT_FULL=n

# LVGL Configuration
CONFIG_LV_CONF_SKIP=n
CONFIG_LV_COLOR_DEPTH_16=y
CONFIG_LV_COLOR_16_SWAP=0
CONFIG_LV_MEM_CUSTOM=y
CONFIG_LV_USE_PERF_MONITOR=n
CONFIG_LV_USE_MEM_MONITOR=n
```
